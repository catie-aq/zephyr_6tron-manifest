## west.yml
```yaml
# Copyright (c) 2023 CATIE
# SPDX-License-Identifier: Apache-2.0

manifest:
  remotes:
    - name: catie-6tron
      url-base: https://github.com/catie-aq

  defaults:
    remote: catie-6tron

  projects:
    - name: 6tron_connector
      repo-path: zephyr_6tron-connector
      revision: eb71c7198f009b1acf726bcfaf8743abafa6b7d8
      path: 6tron/6tron_connector

    # ================== Zest_Core Boards ==================
    - name: zest_core_fmlr-72
      repo-path: zephyr_zest-core-fmlr-72
      revision: 9190a77bf81443fa8b2736e3cba255936a5856ea
      path: 6tron/boards/zest_core_fmlr-72
    - name: zest_core_mtxdot
      repo-path: zephyr_zest-core-mtxdot
      revision: 07bb7379b163937d3b9e6ca179f532efe6bca0f1
      path: 6tron/boards/zest_core_mtxdot
    - name: zest_core_nrf52832
      repo-path: zephyr_zest-core-nrf52832
      revision: 2ae276df36d2334d27db932a30ad2ea9cc04ec61
      path: 6tron/boards/zest_core_nrf52832
    - name: zest_core_nrf5340
      repo-path: zephyr_zest-core-nrf5340
      revision: 87b266acbd415be1c4719778e3909e8ff899f480
      path: 6tron/boards/zest_core_nrf5340
    - name: zest_core_stm32g474ve
      repo-path: zephyr_zest-core-stm32g474ve
      revision: 3b9d10d3d68f74591008a3751c6dbc002741998c
      path: 6tron/boards/zest_core_stm32g474ve
    - name: zest_core_stm32h753zi
      repo-path: zephyr_zest-core-stm32h753zi
      revision: a8c4243407ef34b8338d3abebc4591200c13dc11
      path: 6tron/boards/zest_core_stm32h753zi
    - name: zest_core_stm32l4a6rg
      repo-path: zephyr_zest-core-stm32l4a6rg
      revision: 6c33f82d3c28cbe04638b5a4389db0eea11b180f
      path: 6tron/boards/zest_core_stm32l4a6rg
    - name: zest_core_stm32l562ve
      repo-path: zephyr_zest-core-stm32l562ve
      revision: 6decaaf1887790d43f3c5bbd85224e122ce01d1a
      path: 6tron/boards/zest_core_stm32l562ve

    # ================= Integrated Devices =================
    - name: z_iaq
      repo-path: zephyr_z-iaq
      revision: 66769d4d1403277218e3a9106de33d2f170bcb22
      path: 6tron/boards/z_iaq
    - name: z_motion
      repo-path: zephyr_z-motion
      revision: 0384bd1bff35e92e6ead82c0ad68fc8217b132ce
      path: 6tron/boards/z_motion

    # ==================== Zest Shields =====================
    - name: zest_adapter_click
      repo-path: zephyr_zest-adapter-click
      revision: d688095f4d5d4e4e024ab1f0bb6f5d577d2a1008
      path: 6tron/shields/zest_adapter_click
    - name: zest_adapter_shield
      repo-path: zephyr_zest-adapter-shield
      revision: 3dc2222b3629cef08942d7904774aa47e6684220
      path: 6tron/shields/zest_adapter_shield
    - name: zest_battery_lipo
      repo-path: zephyr_zest-battery-lipo
      revision: 25bc25874ac235447c44dae25783346c8ad538a9
      path: 6tron/shields/zest_battery_lipo
    - name: zest_conditioning_fastadc
      remote: catie-6tron
      repo-path: zephyr_zest-conditioning-fastadc
      revision: 02d11a8b2325f7695cd6d80cfb9b8605aaa15ae9
      path: 6tron/shields/zest_conditioning_fastadc
    - name: zest_display_lcd
      repo-path: zephyr_zest-display-lcd
      revision: 54d11ff495b2d519741e1f62ae3877ce0ef34ffa
      path: 6tron/shields/zest_display_lcd
    - name: zest_interface_ethernet
      repo-path: zephyr_zest-interface-ethernet
      revision: 7c61f05482434c9e79abe1525777195f85632018
      path: 6tron/shields/zest_interface_ethernet
    - name: zest_interface_rs232
      repo-path: zephyr_zest-interface-rs232
      revision: 09def4139c923709e8ec2f3a68b9910d23619ae8
      path: 6tron/shields/zest_interface_rs232
    - name: zest_interface_rs485
      repo-path: zephyr_zest-interface-rs485
      revision: 316b980980d1b9ea91253aa528d559e15616f858
      path: 6tron/shields/zest_interface_rs485
    - name: zest_radio_gnss
      repo-path: zephyr_zest-radio-gnss
      revision: 74ab5c21ab63b11a4c569ea8f8356bcfa99055aa
      path: 6tron/shields/zest_radio_gnss
    - name: zest_radio_lora868
      repo-path: zephyr_zest-radio-lora868
      revision: e84a205b77c0742266ccc04f7097e0d24f7d8422
      path: 6tron/shields/zest_radio_lora868
    - name: zest_radio_wifi
      repo-path: zephyr_zest-radio-wifi
      revision: bfe3759bb9df3bd67bc0bc0ea59e535a043e28c7
      path: 6tron/shields/zest_radio_wifi
    - name: zest_rtc_rv-8803-c7
      repo-path: zephyr_zest-rtc-rv-8803-c7
      revision: 94318a46f0e6be418726719ca97f273365feed9b
      path: 6tron/shields/zest_rtc_rv-8803-c7
    - name: zest_security_secureelement
      repo-path: zephyr_zest-security-secureelement
      revision: d19e5c10302cb0b55b4d8281359daa1770234427
      path: 6tron/shields/zest_security_secureelement
    - name: zest_sensor_imu
      repo-path: zephyr_zest-sensor-imu
      revision: 3ae598bb96386a4ecfe8e236c50b408e28ce8411
      path: 6tron/shields/zest_sensor_imu
    - name: zest_sensor_p-t-rh
      repo-path: zephyr_zest-sensor-p-t-rh
      revision: cfd8ded7c0ba8fc20476c47115555d187d3d94d5
      path: 6tron/shields/zest_sensor_p-t-rh
    - name: zest_storage_microsd
      repo-path: zephyr_zest-storage-microsd
      revision: 381f3067c69ea1114dc11412492a2bc92c776845
      path: 6tron/shields/zest_storage_microsd
    - name: zest_test_hmi
      repo-path: zephyr_zest-test-hmi
      revision: 9b08dac4de128bc1fb69d3c2349a022aca1285cd
      path: 6tron/shields/zest_test_hmi

    # ====================== Drivers =======================
    - name: bosch_bno055
      repo-path: zephyr_bosch-bno055
      revision: 01cac75900328437e29e08f512e48458a55c1395
      path: 6tron/drivers/bosch_bno055
    - name: honeywell_hpma115
      repo-path: zephyr_honeywell-hpma115
      revision: 1cdd374d59bfa5d9d5b8b1122cb2c5b3dcfb3443
      path: 6tron/drivers/honeywell_hpma115
    - name: lltc_ltc2311-16
      repo-path: zephyr_lltc-ltc2311-16
      remote: catie-6tron
      revision: 4e8acacdf25a7deeeba730dc429f2889e3fb8ddb
      path: 6tron/drivers/lltc_ltc2311-16
    - name: maxim_max17201
      repo-path: zephyr_maxim-max17201
      revision: 9034c7a00611ad583e43de5d5c41134a2b887be4
      path: 6tron/drivers/maxim_max17201
    - name: microchip_mcp3425
      repo-path: zephyr_microchip-mcp3425
      revision: 6d6744f29e2cb13f7df275593d38e1d59977252b
      path: 6tron/drivers/microchip_mcp3425
    - name: microcrystal_rv8803
      repo-path: zephyr_microcrystal-rv8803
      revision: e8bc1f60fb90962b633e88b6084c13336ea822dc
      path: 6tron/drivers/microcrystal_rv8803
    - name: quectel_l86
      repo-path: zephyr_quectel-l86
      revision: 69963b65687af9a1545199488d61f8bc69ee97f8
      path: 6tron/drivers/quectel_l86
    - name: st-stsafe-a1xx
      repo-path: zephyr_st-stsafe-a1xx
      revision: 1f7dbf66e33926daa69585156bab50ee5d0a12f7
      path: 6tron/drivers/st-stsafe-a1xx
      import: true
    - name: te-connectivity_htu21d
      repo-path: zephyr_te-connectivity-htu21d
      revision: 686f031e6f42163d5de630ccf29749e1cfed8335
      path: 6tron/drivers/te-connectivity_htu21d
    - name: ti_tsc2003
      repo-path: zephyr_ti-tsc2003
      revision: dc42e6145b39808a4dc5809db0f430c2648ec7ed
      path: 6tron/drivers/ti_tsc2003
```
